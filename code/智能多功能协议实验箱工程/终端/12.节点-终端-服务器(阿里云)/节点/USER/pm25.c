#include "pm25.h"


float pm25_val;

/*****************************************************
函数名称：PM25_Gpio_Init
函数功能：PM2.5传感器使用的GPIO初始化
函数参数：无
函数返回值：无
备注：
	传感器只能接在板子右边
	PA0-----ADC1_IN0
	PB5-----PWM
版本：V1.0
作者：ZZXYD
*******************************************************/
void PM25_Gpio_Init(void)
{
#if(PM25_POS == RIGHT_POS)
	//开时钟
	RCC->APB2ENR |= (1 << 2)|(1 << 3)|(1 << 10);//GPIOA GPIOB  ADC2
	//配置PB5
	GPIOB->CRL &= ~(0xf << 20);
	GPIOB->CRL |= (0x3 << 20);
	//配置  PA0
	GPIOA->CRL &=~ (0xf << 0);//模拟输入模式
	ADC2->CR2 |= (1 << 20);//使用外部事件启动转换
	ADC2->CR2 |= (7 << 17);//软件触发
	ADC2->SMPR2 |= (7 << 0);//最长采样周期
	ADC2->SQR1 &=~ (0xf << 20);//开启一个转换序列
	ADC2->SQR3 &=~ (0x1f << 0);
	ADC2->SQR3 |= (0 << 0);//序列一里为通道1
	ADC2->CR2 |= (1 << 0);//开启adc	
	//校准
	ADC2->CR2 |= (1<<3);
	while(ADC2->CR2 & (1<<3));
	ADC2->CR2 |= (1<<2);
	while(ADC2->CR2 & (1<<2));	
//	ADC2->CR2 |= (1 << 22);//开启转换
#endif
}

/*****************************************************
函数名称：PM25_Get_Value
函数功能：读取PM2.5传感器的数据
函数参数：无
函数返回值：当前环境PM2.5浓度值
备注：
版本：V1.0
作者：ZZXYD
*******************************************************/
float PM25_Get_Value(void)
{
	u16 Pm25;
	float pm;
	PM25_Low();
	delay_us(280);
	ADC2->CR2 |= (1 << 22);//开启转换
	while((ADC2->SR & (1<<1)) == 0);
	Pm25 = ADC2->DR;
	delay_us(40);
	PM25_High();
	delay_us(9680);
	pm = 0.17*Pm25-0.1; //电压-灰尘转换
	return pm;
}

/*****************************************************
函数名称：PM25_Show_Usart
函数功能：读取PM2.5传感器的数据,并且在串口显示
函数参数：无
函数返回值：获取到的PM2.5浓度值
备注：
版本：V1.0
作者：ZZXYD
*******************************************************/
float PM25_Show_Usart(void)
{
	pm25_val = PM25_Get_Value();
	printf("pm25_val = %.2fmg/m3\r\n",pm25_val);
	return pm25_val;
}


